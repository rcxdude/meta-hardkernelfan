## conf/layer.conf
```bitbake
# We have a conf and classes directory, append to BBPATH
BBPATH .= ":${LAYERDIR}"

# We have a recipes directory, add to BBFILES
BBFILES += "${LAYERDIR}/recipes*/*/*.bb ${LAYERDIR}/recipes*/*/*.bbappend"

BBFILE_COLLECTIONS += "hardkernelfan-layer"
BBFILE_PATTERN_hardkernelfan-layer := "^${LAYERDIR}/"
BBFILE_PRIORITY_hardkernelfan-layer = "6"
```

## conf/machine/odroid-u2.conf
```bitbake
#@TYPE: Machine
#@NAME: ODROID-U2 machine
#@DESCRIPTION: Machine configuration for the Hardkernel ODROID-U2
#@MAINTAINER: James Buckley

require conf/machine/include/tune-cortexa9.inc

PREFERRED_PROVIDER_virtual/xserver = "xserver-xorg"
XSERVER = "xserver-xorg \
           xf86-input-evdev \
           xf86-video-fbdev"

# Only has DVI connector for external screen
GUI_MACHINE_CLASS = "bigscreen"

MACHINE_KERNEL_PR = "r1"

PREFERRED_PROVIDER_virtual/kernel = "linux-odroid-u2_3.0.60"
KERNEL_IMAGETYPE = "uImage"

IMAGE_FSTYPES += "tar.bz2 "

# Guesswork
SERIAL_CONSOLE = "115200 ttyO0"

# and sdio
MACHINE_FEATURES = "kernel26 screen apm usbgadget usbhost vfat alsa"

# For a modularized kernel we want to drag in networking
MACHINE_EXTRA_RRECOMMENDS = "kernel-module-smsc95xx"
```
